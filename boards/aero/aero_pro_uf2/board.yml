## boards/aero/aero_pro_uf2/board.yml
```yaml
# Copyright (c) 2024 Nordic Semiconductor ASA
# SPDX-License-Identifier: Apache-2.0

board:
  name: aero_pro_uf2
  vendor: aero
  socs:
    - name: nrf52840
```

## boards/aero/aero_tracker/board.yml
```yaml
# Copyright (c) 2024 Nordic Semiconductor ASA
# SPDX-License-Identifier: Apache-2.0

board:
  name: aero_tracker_uf2
  full_name: AeroTracker
  vendor: aero
  socs:
    - name: nrf52840
```

## boards/dawnoriginal/dawn_tracker_mini_uf2/board.yml
```yaml
# Copyright (c) 2026
# SPDX-License-Identifier: Apache-2.0

board:
  name: dawn_tracker_mini_uf2
  full_name: Dawn Tracker Mini
  vendor: dawnoriginal
  socs:
    - name: nrf52833
```

## boards/estenova/estmini_uf2/board.yml
```yaml
# Copyright (c) 2024 Nordic Semiconductor ASA
# SPDX-License-Identifier: Apache-2.0

board:
  name: estmini_uf2
  full_name: Estmini Mini
  vendor: nordic
  socs:
    - name: nrf52840
```

## boards/foxapplication/foxsmol40/board.yml
```yaml
# Copyright (c) 2024 Nordic Semiconductor ASA
# SPDX-License-Identifier: Apache-2.0

board:
  name: foxsmol40_uf2
  full_name: FoxApplication foxsmol40 Tracker
  vendor: foxapplication
  socs:
    - name: nrf52840
```

## boards/foxapplication/foxsmolv1_spi_uf2/board.yml
```yaml
# Copyright (c) 2024 Nordic Semiconductor ASA
# SPDX-License-Identifier: Apache-2.0

board:
  name: foxsmolv1_spi_uf2
  full_name: FoxApplication FoxSmolV1 Tracker SPI
  vendor: foxapplication
  socs:
    - name: nrf52840
```

## boards/foxapplication/foxsnackeco/board.yml
```yaml
# Copyright (c) 2024 Nordic Semiconductor ASA
# SPDX-License-Identifier: Apache-2.0

board:
  name: foxsnackeco_uf2
  full_name: FoxApplication FoxSnackECO Tracker
  vendor: foxapplication
  socs:
    - name: nrf52840
```

## boards/foxapplication/foxsnacklite/board.yml
```yaml
# Copyright (c) 2024 Nordic Semiconductor ASA
# SPDX-License-Identifier: Apache-2.0

board:
  name: foxsnacklite_uf2
  full_name: FoxApplication FoxSnackLite Tracker
  vendor: foxapplication
  socs:
    - name: nrf52840
```

## boards/foxapplication/foxsnacklitev3/Kconfig.foxsnacklitev3_uf2
```kconfig
# Copyright (c) 2024 Nordic Semiconductor ASA
# SPDX-License-Identifier: Apache-2.0

config BOARD_FOXSNACKLITEV3_UF2
	select SOC_NRF52840_QIAA
```

## boards/foxapplication/foxsnacklitev3/board.yml
```yaml
# Copyright (c) 2024 Nordic Semiconductor ASA
# SPDX-License-Identifier: Apache-2.0

board:
  name: foxsnacklitev3_uf2
  full_name: FoxApplication FoxSnackLiteV3 Tracker
  vendor: foxapplication
  socs:
    - name: nrf52840
```

## boards/hulimiao/hulimiao_tracker/Kconfig.hulimiao_tracker
```kconfig
# Copyright (c) 2024 Nordic Semiconductor ASA
# SPDX-License-Identifier: Apache-2.0

config BOARD_HULIMIAO_TRACKER
	select SOC_NRF52833_QDAA
```

## boards/hulimiao/hulimiao_tracker/board.yml
```yaml
# Copyright (c) 2024 Nordic Semiconductor ASA
# SPDX-License-Identifier: Apache-2.0

board:
  name: hulimiao_tracker
  vendor: hulimiao
  socs:
    - name: nrf52833
```

## boards/hulimiao/nekonya_tracker_uf2/board.yml
```yaml
# Copyright (c) 2024 Nordic Semiconductor ASA
# SPDX-License-Identifier: Apache-2.0

board:
  name: nekonya_tracker_uf2
  full_name: NekoNya Tracker
  vendor: hulimiao
  socs:
    - name: nrf52833
```

## boards/kekkels/paper-smol-v1/Kconfig.paper_smol_v1_uf2
```kconfig
# Copyright (c) 2024 Nordic Semiconductor ASA
# SPDX-License-Identifier: Apache-2.0

config BOARD_PAPER_SMOL_V1_UF2
	select SOC_NRF52833_QDAA
```

## boards/kekkels/paper-smol-v1/board.yml
```yaml
# Copyright (c) 2024 Nordic Semiconductor ASA
# SPDX-License-Identifier: Apache-2.0

board:
  name: paper_smol_v1_uf2
  full_name: "Paper Smol Version 1" 
  vendor: kekkels
  socs:
    - name: nrf52833
```

## boards/kekkels/paper-smol-v1/paper_smol_v1_uf2_defconfig
```kconfig
CONFIG_ARM_MPU=y
CONFIG_HW_STACK_PROTECTION=y

CONFIG_SLIMEVR_USB_DEVICE_MANUFACTURER="kekkels"
CONFIG_SLIMEVR_USB_DEVICE_PRODUCT="paper_smol_v1"

CONFIG_BATTERY_USE_REG_LDO_MAPPING=y
CONFIG_LED_RGB_COLOR=n

CONFIG_SENSOR_ROTATION_270=y

#generate for adafruit uf2 bootloader flashing
CONFIG_BUILD_OUTPUT_UF2=y
CONFIG_FLASH_LOAD_OFFSET=0x1000
CONFIG_BUILD_OUTPUT_UF2_FAMILY_ID="0x621e937a"
```

## boards/kemopati/sk_cheesecake_nrf_p00/Kconfig.sk_cheesecake_nrf_p00
```kconfig
# Copyright (c) 2026
# SPDX-License-Identifier: Apache-2.0

config BOARD_SK_CHEESECAKE_NRF_P00
	select SOC_NRF52840_QIAA
```

## boards/kemopati/sk_cheesecake_nrf_p00/board.yml
```yaml
# Copyright (c) 2026
# SPDX-License-Identifier: Apache-2.0

board:
  name: sk_cheesecake_nrf_p00
  full_name: KemoPati SK CheeseCake NRF P00
  vendor: kemopati
  socs:
    - name: nrf52840
      variants:
        - name: uf2
```

## boards/kemopati/sk_cheesecake_nrf_p00/sk_cheesecake_nrf_p00_nrf52840_uf2_defconfig
```kconfig
# Copyright (c) 2026
# SPDX-License-Identifier: Apache-2.0

CONFIG_ARM_MPU=y
CONFIG_HW_STACK_PROTECTION=y

CONFIG_SLIMEVR_USB_DEVICE_MANUFACTURER="KemoPati"
CONFIG_SLIMEVR_USB_DEVICE_PRODUCT="SlimeNRF Tracker SK CheeseCake NRF P00"

CONFIG_CUSTOMER_INFO_SKT0=y
CONFIG_CUSTOMER_INFO_SKT0_PRODUCT_ID=1
CONFIG_CUSTOMER_INFO_SKT0_HARDWARE_REVISION=0

CONFIG_BATTERY_USE_REG_LDO_MAPPING=y
CONFIG_SENSOR_ROTATION_0=y

CONFIG_LED_RGB_COLOR=y
CONFIG_LED_STRIP=y
CONFIG_LED_GLOBAL_BRIGHTNESS_PPTT=1000
CONFIG_LED_DEFAULT_COLOR_R=10000
CONFIG_LED_DEFAULT_COLOR_G=3137
CONFIG_LED_DEFAULT_COLOR_B=5294

# Generate for Adafruit UF2 bootloader flashing.
CONFIG_BUILD_OUTPUT_UF2=y
CONFIG_BUILD_OUTPUT_UF2_FAMILY_ID="0xADA52840"
```

## boards/kemopati/sk_cheesecake_nrf_p10/Kconfig
```kconfig
# SPDX-License-Identifier: Apache-2.0

rsource "../sk_common/Kconfig.customer_info"
```

## boards/kemopati/sk_cheesecake_nrf_p10/Kconfig.sk_cheesecake_nrf_p10
```kconfig
# Copyright (c) 2026
# SPDX-License-Identifier: Apache-2.0

config BOARD_SK_CHEESECAKE_NRF_P10
	select SOC_NRF52840_QIAA
```

## boards/kemopati/sk_cheesecake_nrf_p10/board.yml
```yaml
# Copyright (c) 2026
# SPDX-License-Identifier: Apache-2.0

board:
  name: sk_cheesecake_nrf_p10
  full_name: KemoPati SK CheeseCake NRF P10
  vendor: kemopati
  socs:
    - name: nrf52840
      variants:
        - name: uf2
```

## boards/kemopati/sk_common/Kconfig.customer_info
```kconfig
# SPDX-License-Identifier: Apache-2.0

config CUSTOMER_INFO_SKT0
	bool "Read legacy SKT0 customer information"
	depends on SOC_SERIES_NRF52
	default n
	help
	  Read the SK factory record in UICR CUSTOMER words 0..15 only when
	  the generic SNCI record in words 16..31 is completely erased.
	  This compatibility reader never writes UICR. This preference is inert
	  when CUSTOMER_INFO is disabled.

config CUSTOMER_INFO_SKT0_PRODUCT_ID
	int "Expected SKT0 product ID (-1 to leave unchecked)"
	depends on SOC_SERIES_NRF52
	range -1 65535
	default -1
	help
	  SKT0 numeric identity is checked only when both this value and
	  CUSTOMER_INFO_SKT0_HARDWARE_REVISION are nonnegative. Zero is valid.
	  This metadata is inert when CUSTOMER_INFO or CUSTOMER_INFO_SKT0 is disabled.

config CUSTOMER_INFO_SKT0_HARDWARE_REVISION
	int "Expected SKT0 hardware revision (-1 to leave unchecked)"
	depends on SOC_SERIES_NRF52
	range -1 65535
	default -1
	help
	  A mismatch is diagnostic and does not invalidate the factory record.
	  This metadata is inert when CUSTOMER_INFO or CUSTOMER_INFO_SKT0 is disabled.
```
