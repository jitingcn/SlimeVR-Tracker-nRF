## boards/dawnoriginal/dawn_tracker_mini_uf2/Kconfig.dawn_tracker_mini_uf2
```kconfig
# Copyright (c) 2026
# SPDX-License-Identifier: Apache-2.0

config BOARD_DAWN_TRACKER_MINI_UF2
	select SOC_NRF52833_QDAA
```

## boards/foxapplication/foxsmol40/Kconfig.foxsmol40_uf2
```kconfig
# Copyright (c) 2024 Nordic Semiconductor ASA
# SPDX-License-Identifier: Apache-2.0

config BOARD_FOXSMOL40_UF2
	select SOC_NRF52840_QIAA
```

## boards/hulimiao/nekonya_tracker_uf2/Kconfig.nekonya_tracker_uf2
```kconfig
# Copyright (c) 2024 Nordic Semiconductor ASA
# SPDX-License-Identifier: Apache-2.0

config BOARD_NEKONYA_TRACKER_UF2
	select SOC_NRF52833_QDAA
```

## boards/hulimiao/nekonya_tracker_uf2/nekonya_tracker_uf2_defconfig
```kconfig
# Copyright (c) 2024 Nordic Semiconductor ASA
# SPDX-License-Identifier: Apache-2.0

CONFIG_ARM_MPU=y
CONFIG_HW_STACK_PROTECTION=y

CONFIG_USB_DEVICE_STACK=y
CONFIG_USB_DEVICE_MANUFACTURER="hulimiao"
CONFIG_USB_DEVICE_PRODUCT="nekonya_tracker_uf2"

CONFIG_BATTERY_USE_REG_BUCK_MAPPING=y

CONFIG_LED_RGB_COLOR=y

CONFIG_DISABLE_SENSOR_GPIOS_ON_SHUTDOWN=y

#generate for adafruit uf2 bootloader flashing
CONFIG_BUILD_OUTPUT_UF2=y
CONFIG_BUILD_OUTPUT_UF2_FAMILY_ID="0x621e937a"
CONFIG_FLASH_LOAD_OFFSET=0x1000
```

## boards/nini_slimevr/nini_slimevr_mag_uf2/Kconfig.nini_slimevr_mag_uf2
```kconfig
# Copyright (c) 2024 Nordic Semiconductor ASA
# SPDX-License-Identifier: Apache-2.0

config BOARD_NINI_SLIMEVR_MAG_UF2
	bool "NiNi SlimeVR MAG UF2 board"
	select SOC_NRF52833_QDAA
	select BOARD_HAS_DTS
	help
	  Enable support for the NiNi SlimeVR MAG UF2 board with PWM RGB LED and I2C magnetometer.
```

## boards/nordic/promicro_uf2/board.yml
```yaml
# Copyright (c) 2024 Nordic Semiconductor ASA
# SPDX-License-Identifier: Apache-2.0

# The 'smspi' board variant is targeted promicro stack with the SM-ICM45686-AK09940A
# where ICM is on SPI, AK is on I2C, external clock disabled.
# The default_spi variant is targeted promicro with the upstream default configuration

board:
  name: promicro_uf2
  vendor: nordic
  socs:
    - name: nrf52840
      variants:
      - name: 'i2c'
      - name: 'spi'
      - name: 'smspi'
      - name: 'chrysalis'
      - name: 'lwkj_icm45v1'
      - name: 'default_spi'
      - name: 'default_i2c'
```

## boards/slimevr/slimevrmini_p4r9_uf2/Kconfig.slimevrmini_p4r9_uf2
```kconfig
# Copyright (c) 2024 Nordic Semiconductor ASA
# SPDX-License-Identifier: Apache-2.0

config BOARD_SLIMEVRMINI_P4R9_UF2
	select SOC_NRF52833_QIAA
```

## boards/styria/styria_mini_uf2/Kconfig.styria_mini_uf2
```kconfig
# Copyright (c) 2024 Nordic Semiconductor ASA
# SPDX-License-Identifier: Apache-2.0

config BOARD_STYRIA_MINI_UF2
	select SOC_NRF52840_QIAA
```

## sample.yaml
```yaml
tests:
  common:
    platform_allow:
      - nrf21540dk/nrf52840
      - nrf52840dk/nrf52840
      - nrf52840dongle/nrf52840
      - nrf52dk/nrf52832
      - nrf5340dk/nrf5340/cpuapp
      - nrf5340dk/nrf5340/cpunet
      - nrf54l15dk/nrf54l15/cpuapp
      - xiao_ble/nrf52840
      - xiao_ble/nrf52840/sense
    sysbuild: true
```
