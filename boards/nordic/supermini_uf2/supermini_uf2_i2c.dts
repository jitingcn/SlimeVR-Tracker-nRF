// Copyright (c) 2024 Nordic Semiconductor ASA
// SPDX-License-Identifier: Apache-2.0

/dts-v1/;
#include "supermini_uf2.dts"

&spi3 {
    status = "disabled";
};

&imu_spi {
    status = "disabled";
};
