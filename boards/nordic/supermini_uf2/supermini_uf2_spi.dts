// Copyright (c) 2024 Nordic Semiconductor ASA
// SPDX-License-Identifier: Apache-2.0

/dts-v1/;
#include "supermini_uf2.dts"

&i2c0 {
	status = "disabled";
};

&imu {
	status = "disabled";
};

&mag {
	status = "disabled";
};
