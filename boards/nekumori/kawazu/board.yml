## boards/nekumori/kawazu/board.yml
```yaml
# Copyright (c) 2024 Nordic Semiconductor ASA
# SPDX-License-Identifier: Apache-2.0

board:
  name: kawazu_uf2
  full_name: Kawazu
  vendor: nekumori
  socs:
    - name: nrf52833
```

## boards/nini_slimevr/nini_slimevr_mag_uf2/board.yml
```yaml
# Copyright (c) 2024 Nordic Semiconductor ASA
# SPDX-License-Identifier: Apache-2.0

board:
  name: nini_slimevr_mag_uf2
  full_name: NiNi_Unicorn & MINGYUE Smol SlimeVR MAG
  vendor: nini_slimevr
  socs:
    - name: nrf52833
```

## boards/nordic/test54l/board.yml
```yaml
board:
  name: test54l
  full_name: Test nRF54L15
  vendor: nordic
  socs:
  - name: nrf54l15
    variants:
    - name: xip
      cpucluster: cpuflpr
```

## boards/nordic/test54l/test54l_nrf54l15_cpuapp_defconfig
```kconfig
CONFIG_ARM_MPU=y
CONFIG_HW_STACK_PROTECTION=y
CONFIG_SENSOR_ROTATION_0=y

CONFIG_NULL_POINTER_EXCEPTION_DETECTION_NONE=y

CONFIG_CACHE_MANAGEMENT=y
CONFIG_EXTERNAL_CACHE=y

CONFIG_NRF_GRTC_START_SYSCOUNTER=y

CONFIG_REGULATOR=y
```

## boards/nordic/test805/test805_defconfig
```kconfig
# Copyright (c) 2024 Nordic Semiconductor ASA
# SPDX-License-Identifier: Apache-2.0

CONFIG_ARM_MPU=y
CONFIG_HW_STACK_PROTECTION=y
CONFIG_SENSOR_ROTATION_0=y
```

## boards/nrf21540dk_nrf52840.conf
```kconfig
CONFIG_SLIMEVR_USB_DEVICE_MANUFACTURER="Nordic Semiconductor"
CONFIG_SLIMEVR_USB_DEVICE_PRODUCT="SlimeNRF Tracker nRF21540 DK"
```

## boards/nrf52840dongle_nrf52840.conf
```kconfig
CONFIG_SLIMEVR_USB_DEVICE_MANUFACTURER="Nordic Semiconductor"
CONFIG_SLIMEVR_USB_DEVICE_PRODUCT="SlimeNRF Tracker nRF52840 Dongle"

CONFIG_LED_RGB_COLOR=y
```

## boards/nrf5340dk_nrf5340_cpuapp.conf
```kconfig
CONFIG_SLIMEVR_USB_DEVICE_MANUFACTURER="Nordic Semiconductor"
CONFIG_SLIMEVR_USB_DEVICE_PRODUCT="SlimeNRF Tracker nRF5340 DK"

CONFIG_ESB=n
```

## boards/seeed/xiao_nrf54lm20a/xiao_nrf54lm20a_nrf54lm20a_cpuapp_defconfig
```kconfig
# Copyright (c) 2025 Seeed Technology Co., Ltd.
# SPDX-License-Identifier: Apache-2.0

CONFIG_ARM_MPU=y
CONFIG_NULL_POINTER_EXCEPTION_DETECTION_NONE=y
CONFIG_CACHE_MANAGEMENT=y
CONFIG_EXTERNAL_CACHE=y
CONFIG_NRF_GRTC_START_SYSCOUNTER=y

CONFIG_GPIO=y
CONFIG_REGULATOR=y
CONFIG_REGULATOR_FIXED_INIT_PRIORITY=45
```

## boards/slimevr/microslime/board.yml
```yaml
# Copyright (c) 2024 Nordic Semiconductor ASA
# SPDX-License-Identifier: Apache-2.0

board:
  name: microslime_uf2
  full_name: Microslime
  vendor: slimevr
  socs:
    - name: nrf52833
```

## boards/spiroooo/miro/board.yml
```yaml
# Copyright (c) 2024 Nordic Semiconductor ASA
# SPDX-License-Identifier: Apache-2.0

board:
  name: miro_uf2
  full_name: Miro
  vendor: spiroooo
  socs:
    - name: nrf52833
```

## boards/styria/styria_mini_uf2/board.yml
```yaml
# Copyright (c) 2024 Nordic Semiconductor ASA
# SPDX-License-Identifier: Apache-2.0

board:
  name: styria_mini_uf2
  full_name: Styria Mini
  vendor: styria
  socs:
    - name: nrf52840
      variants:
      - name: 'spi'
```

## boards/xiao_nrf54lm20a_nrf54lm20a_cpuapp.conf
```kconfig
CONFIG_SERIAL=y
CONFIG_CONSOLE=y
CONFIG_UART_CONSOLE=y
CONFIG_SENSOR=y

CONFIG_SLIMEVR_USB_DEVICE_MANUFACTURER="Seeed Studio"
CONFIG_SLIMEVR_USB_DEVICE_PRODUCT="SlimeNRF Tracker XIAO nRF54LM20A"
CONFIG_BATTERY_USE_REG_LDO_MAPPING=y
CONFIG_LED_RGB_COLOR=y
```

## boards/xiao_nrf54lm20a_nrf54lm20a_cpuapp_sense.conf
```kconfig
CONFIG_SERIAL=y
CONFIG_CONSOLE=y
CONFIG_UART_CONSOLE=y
CONFIG_SENSOR=y

CONFIG_SLIMEVR_USB_DEVICE_MANUFACTURER="Seeed Studio"
CONFIG_SLIMEVR_USB_DEVICE_PRODUCT="SlimeNRF Tracker XIAO nRF54LM20A Sense"
CONFIG_BATTERY_USE_REG_LDO_MAPPING=y
CONFIG_LED_RGB_COLOR=y

CONFIG_SENSOR_IMU_DRIVERS_MINIMAL=y
CONFIG_SENSOR_DRV_LSM6DSM=y
CONFIG_SENSOR_MAG_DRIVERS_MINIMAL=y
```

## tests/zephyr/cal_sample/testcase.yaml
```yaml
tests:
  tracker.calibration.samples:
    tags:
      - kernel
      - sensor
      - calibration
    platform_allow:
      - native_sim/native/64
    integration_platforms:
      - native_sim/native/64
```

## tests/zephyr/hfxo_lifecycle/testcase.yaml
```yaml
tests:
  tracker.hfxo_lifecycle.nrf52:
    tags:
      - kernel
      - radio
    platform_allow:
      - native_sim/native/64
    integration_platforms:
      - native_sim/native/64
  tracker.hfxo_lifecycle.nrf54:
    tags:
      - kernel
      - radio
    extra_args:
      - HFXO_NRF54=ON
    platform_allow:
      - native_sim/native/64
    integration_platforms:
      - native_sim/native/64
  tracker.hfxo_lifecycle.lf_synth:
    tags:
      - kernel
      - radio
    extra_args:
      - HFXO_SYNTH=ON
    platform_allow:
      - native_sim/native/64
    integration_platforms:
      - native_sim/native/64
  tracker.hfxo_lifecycle.nrf54_lf_synth:
    tags:
      - kernel
      - radio
    extra_args:
      - HFXO_NRF54=ON
      - HFXO_SYNTH=ON
    platform_allow:
      - native_sim/native/64
    integration_platforms:
      - native_sim/native/64
```

## tests/zephyr/hid_lifecycle/testcase.yaml
```yaml
tests:
  tracker.hid.lifecycle:
    tags:
      - kernel
      - usb
      - hid
    platform_allow:
      - native_sim/native/64
    integration_platforms:
      - native_sim/native/64
```

## tests/zephyr/power_request/testcase.yaml
```yaml
tests:
  tracker.power.request:
    tags:
      - kernel
      - power
    platform_allow:
      - native_sim/native/64
    integration_platforms:
      - native_sim/native/64
```

## tests/zephyr/sensor_recovery/testcase.yaml
```yaml
tests:
  tracker.sensor.recovery:
    tags:
      - kernel
      - sensor
    platform_allow:
      - native_sim/native/64
    integration_platforms:
      - native_sim/native/64
```
